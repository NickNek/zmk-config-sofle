## config/boards/shields/sofle_own/Kconfig.shield
```kconfig
# Copyright (c) 2020 Ryan Cross
# SPDX-License-Identifier: MIT

config SHIELD_sofle_own_LEFT
    def_bool $(shields_list_contains,sofle_own_left)

config SHIELD_sofle_own_RIGHT
    def_bool $(shields_list_contains,sofle_own_right)
```
